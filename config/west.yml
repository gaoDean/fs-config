## config/west.yml
```yaml
manifest:
  remotes:
    - name: zmkfirmware
      url-base: https://github.com/zmkfirmware
    - name: gaoDean
      url-base: https://github.com/gaoDean
  projects:
    - name: zmk
      remote: gaoDean
      revision: main
      import: app/west.yml
  self:
    path: config
```
